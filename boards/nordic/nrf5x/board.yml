## boards/nordic/nrf5x/board.yml
```yaml
board:
  name: nrf5x
  full_name: nRF52840 DK
  vendor: nordic
  socs:
  # Physical nRF52840 SoC on PCA10056
  - name: nrf52840
  # nRF52840 SoC in nRF52811 emulation mode on PCA10056
  - name: nrf52811
```
